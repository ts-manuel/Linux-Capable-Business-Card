## linux/external/configs/buildroot_lcbc_sd_linux_dt_defconfig
```kconfig
BR2_arm=y
BR2_TOOLCHAIN_BUILDROOT_CXX=y
BR2_TARGET_GENERIC_HOSTNAME="lcbc"
BR2_TARGET_GENERIC_ISSUE="Welcome to the Linux Capable Business Card"
BR2_TARGET_GENERIC_GETTY_PORT="ttyGS0"
BR2_TARGET_GENERIC_GETTY_BAUDRATE_115200=y
BR2_ROOTFS_POST_IMAGE_SCRIPT="support/scripts/genimage.sh"
BR2_ROOTFS_POST_SCRIPT_ARGS="-c $(BR2_EXTERNAL_LCBC_PATH)/board/lcbc_sd_linux_dt/genimage.cfg"
BR2_LINUX_KERNEL=y
BR2_LINUX_KERNEL_USE_CUSTOM_CONFIG=y
BR2_LINUX_KERNEL_CUSTOM_CONFIG_FILE="$(BR2_EXTERNAL_LCBC_PATH)/board/lcbc_sd_linux_dt/linux_defconfig"
BR2_LINUX_KERNEL_DTS_SUPPORT=y
BR2_LINUX_KERNEL_CUSTOM_DTS_PATH="$(BR2_EXTERNAL_LCBC_PATH)/board/lcbc_sd_linux_dt/at91sam9n12ek.dts"
BR2_PACKAGE_DHRYSTONE=y
BR2_PACKAGE_RAMSPEED=y
BR2_PACKAGE_STRESS=y
BR2_PACKAGE_WHETSTONE=y
BR2_PACKAGE_GNUCHESS=y
BR2_PACKAGE_SL=y
BR2_PACKAGE_SDL=y
BR2_PACKAGE_SDL_MIXER=y
BR2_PACKAGE_SDL_NET=y
BR2_PACKAGE_MEMTESTER=y
BR2_TARGET_ROOTFS_EXT2=y
BR2_TARGET_ROOTFS_EXT2_4=y
# BR2_TARGET_ROOTFS_TAR is not set
BR2_TARGET_AT91BOOTSTRAP3=y
BR2_TARGET_AT91BOOTSTRAP3_CUSTOM_GIT=y
BR2_TARGET_AT91BOOTSTRAP3_CUSTOM_REPO_URL="https://github.com/linux4sam/at91bootstrap.git"
BR2_TARGET_AT91BOOTSTRAP3_CUSTOM_REPO_VERSION="at91bootstrap-3.x"
BR2_TARGET_AT91BOOTSTRAP3_CUSTOM_PATCH_DIR="$(BR2_EXTERNAL_LCBC_PATH)/patches/"
BR2_TARGET_AT91BOOTSTRAP3_USE_CUSTOM_CONFIG=y
BR2_TARGET_AT91BOOTSTRAP3_CUSTOM_CONFIG_FILE="$(BR2_EXTERNAL_LCBC_PATH)/board/lcbc_sd_linux_dt/at91bootstrap.config"
BR2_PACKAGE_HOST_DOSFSTOOLS=y
BR2_PACKAGE_HOST_GENIMAGE=y
BR2_PACKAGE_HOST_MTOOLS=y
```
